## main/Kconfig.projbuild
```kconfig
menu "Bakelite Bluetooth Phone Config"
    config EXAMPLE_SSP_ENABLED
        bool "Secure Simple Pairing"
        depends on BT_CLASSIC_ENABLED
        default y
        help
            This enables the Secure Simple Pairing. If disable this option,
            Bluedroid will only support Legacy Pairing
endmenu
```
